## main/Kconfig.projbuild
```kconfig
menu "Example Configuration"

    config ESP_WIFI_SSID
        string "WiFi SSID"
        default "Name"
        help
            SSID (network name) for the example to connect to.

    config ESP_WIFI_PASSWORD
        string "WiFi Password"
        default "Password"
        help
            WiFi password (WPA or WPA2) for the example to use.

    config ESP_MAXIMUM_RETRY
        int "Maximum retry"
        default 5
        help
            Set the Maximum retry to avoid station reconnecting to the AP unlimited when the AP is really inexistent.

    config AWS_BROKER_URL
        string "AWS IoT Core MQTT Broker URL"
        default "mqtts://enpoint:porta"
        help
            Enter the URL of the MQTT broker for AWS IoT Core, that is the endpoint.
    
endmenu
```
